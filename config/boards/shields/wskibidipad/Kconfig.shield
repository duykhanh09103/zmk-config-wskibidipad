## config/boards/shields/wskibidipad/Kconfig.shield
```kconfig
# No whitespace after the comma or in your keyboard name!
config SHIELD_WSKIBIDIPAD
    def_bool $(shields_list_contains,wskibdipad)
```
